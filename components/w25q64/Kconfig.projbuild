## components/w25q64/Kconfig.projbuild
```kconfig
menu "W25Q64 Configuration"

	config GPIO_RANGE_MAX
		int
		default 33 if IDF_TARGET_ESP32
		default 46 if IDF_TARGET_ESP32S2
		default 19 if IDF_TARGET_ESP32C3
		default 48 if IDF_TARGET_ESP32S3

	config MISO_GPIO
		int "MISO GPIO number"
		range 0 GPIO_RANGE_MAX
		default 19 if IDF_TARGET_ESP32
		default 37 if IDF_TARGET_ESP32S2
		default 37 if IDF_TARGET_ESP32S3
		default 18 if IDF_TARGET_ESP32C3
		help
			GPIO number (IOxx) to SPI MISO.
			Some GPIOs are used for other purposes (flash connections, etc.) and cannot be used to MISO.
			On the ESP32, GPIOs 35-39 are input-only so cannot be used as outputs.
			On the ESP32-S2, GPIO 46 is input-only so cannot be used as outputs.

	config MOSI_GPIO
		int "MOSI GPIO number"
		range 0 GPIO_RANGE_MAX
		default 23 if IDF_TARGET_ESP32
		default 35 if IDF_TARGET_ESP32S2
		default 35 if IDF_TARGET_ESP32S3
		default 19 if IDF_TARGET_ESP32C3
		help
			GPIO number (IOxx) to SPI MOSI.
			Some GPIOs are used for other purposes (flash connections, etc.) and cannot be used to MOSI.
			On the ESP32, GPIOs 35-39 are input-only so cannot be used as outputs.
			On the ESP32-S2, GPIO 46 is input-only so cannot be used as outputs.

	config SCLK_GPIO
		int "SCLK GPIO number"
		range 0 GPIO_RANGE_MAX
		default 18 if IDF_TARGET_ESP32
		default 36 if IDF_TARGET_ESP32S2
		default 36 if IDF_TARGET_ESP32S3
		default 10 if IDF_TARGET_ESP32C3
		help
			GPIO number (IOxx) to SPI SCLK.
			Some GPIOs are used for other purposes (flash connections, etc.) and cannot be used to SCLK.
			On the ESP32, GPIOs 35-39 are input-only so cannot be used as outputs.
			On the ESP32-S2, GPIO 46 is input-only so cannot be used as outputs.

	config CS_GPIO
		int "CS GPIO number"
		range 0 GPIO_RANGE_MAX
		default 5 if IDF_TARGET_ESP32
		default 34 if IDF_TARGET_ESP32S2
		default 34 if IDF_TARGET_ESP32S3
		default 9  if IDF_TARGET_ESP32C3
		help
			GPIO number (IOxx) to SPI CS.
			Some GPIOs are used for other purposes (flash connections, etc.) and cannot be used to CS.
			On the ESP32, GPIOs 35-39 are input-only so cannot be used as outputs.
			On the ESP32-S2, GPIO 46 is input-only so cannot be used as outputs.

	config 4B_MODE
		bool "Enable 4-Byte Address Mode"
		default false
		help
			Enable 4-Byte Address Mode.

	choice SPI_HOST
		prompt "SPI peripheral that controls this bus"
		default SPI2_HOST
		help
			Select SPI peripheral that controls this bus.
		config SPI2_HOST
			bool "SPI2_HOST"
			help
				Use SPI2_HOST. This is also called HSPI_HOST.
		config SPI3_HOST
			bool "SPI3_HOST"
			help
				USE SPI3_HOST. This is also called VSPI_HOST
	endchoice
endmenu
```

## main/Kconfig.projbuild
```kconfig
menu "W25Q64 Configuration"

	choice SPI_BUS
		prompt "SPI BUS"
		default SPI2
		help
			Select SPI BUS.
		config SPI2
			bool "SPI2"
			help
				SPI BUS is SPI2.
				On the ESP32, MISO GPIO12. MOSI GPIO13. SCLK GPIO14.
				On the ESP32S2, MISO GPIO13. MOSI GPIO11. SCLK GPIO12
		config SPI3
			bool "SPI3"
			help
				SPI BUS is SPI3.
				On the ESP32, MISO GPIO19. MOSI GPIO23. SCLK GPIO18.
				On the ESP32S2, MISO GPIO33. MOSI GPIO35. SCLK GPIO36.
		config CUSTOM_SPI
			bool "CUSTOM"
			help
				SPI BUS is CUSTOM.
	endchoice

	config MISO_GPIO
		depends on CUSTOM_SPI
		int "MISO GPIO number"
		range 0 46
		default 12 if IDF_TARGET_ESP32
		default 13 if IDF_TARGET_ESP32S2
		help
			GPIO number (IOxx) to SPI MISO.
			Some GPIOs are used for other purposes (flash connections, etc.) and cannot be used to MISO.
			On the ESP32, GPIOs 35-39 are input-only so cannot be used as outputs.
			On the ESP32-S2, GPIO 46 is input-only so cannot be used as outputs.

	config MOSI_GPIO
		depends on CUSTOM_SPI
		int "MOSI GPIO number"
		range 0 46
		default 13 if IDF_TARGET_ESP32
		default 11 if IDF_TARGET_ESP32S2
		help
			GPIO number (IOxx) to SPI MOSI.
			Some GPIOs are used for other purposes (flash connections, etc.) and cannot be used to MOSI.
			On the ESP32, GPIOs 35-39 are input-only so cannot be used as outputs.
			On the ESP32-S2, GPIO 46 is input-only so cannot be used as outputs.

	config SCLK_GPIO
		depends on CUSTOM_SPI
		int "SCLK GPIO number"
		range 0 46
		default 14 if IDF_TARGET_ESP32
		default 12 if IDF_TARGET_ESP32S2
		help
			GPIO number (IOxx) to SPI SCLK.
			Some GPIOs are used for other purposes (flash connections, etc.) and cannot be used to SCLK.
			On the ESP32, GPIOs 35-39 are input-only so cannot be used as outputs.
			On the ESP32-S2, GPIO 46 is input-only so cannot be used as outputs.

	config CS_GPIO
		int "CS GPIO number"
		range 0 46
		default 15 if IDF_TARGET_ESP32
		default 34 if IDF_TARGET_ESP32S2
		help
			GPIO number (IOxx) to SPI CS.
			Some GPIOs are used for other purposes (flash connections, etc.) and cannot be used to CS.
			On the ESP32, GPIOs 35-39 are input-only so cannot be used as outputs.
			On the ESP32-S2, GPIO 46 is input-only so cannot be used as outputs.

endmenu
```
